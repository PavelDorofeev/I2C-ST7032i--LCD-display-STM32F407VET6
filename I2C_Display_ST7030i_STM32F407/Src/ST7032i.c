
#include "ST7032i.h"


// font 8*5   CP866
const uint8_t FontTable[256][5] = {
   { 0x00, 0x00, 0x00, 0x00, 0x00 },   //   0x00   0
   { 0x00, 0x00, 0x00, 0x00, 0x00 },   //   0x01   1
   { 0x00, 0x00, 0x00, 0x00, 0x00 },   //   0x02   2
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   { 0x48, 0x54, 0x34, 0x14, 0x7C }    //   0xFF 255
};

I2C_HandleTypeDef *pI2C_LCD;

uint8_t tx[150];

uint8_t txBuf[200];

uint8_t bb[4][130]={
		{0xC0,0x00,0x40,0x00,0x00,0x00,0x00,0x00,0x00,0x00,0x00,0x00,0x00,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0x00,0x00}
};



void before_LCD_print(uint8_t numString)
{
	uint8_t kk=0;

/*	tx[kk++]=LCD_CO_MORE_CONTROL_BYTE_ON  | LCD_INSTRUCTION_TYPE; //0x80;

	tx[kk++]=LCD_ENTRY_MODE_SET //These operations are performed during data write and read
			| LCD_ENTRY_MODE_SET_INCREMENT
			| LCD_ENTRY_MODE_SET_SHIFT_DISPLAY_ON;*/


	tx[kk++]=LCD_CO_MORE_CONTROL_BYTE_ON | LCD_INSTRUCTION_TYPE; //0x80;
	tx[kk++]=0b00000000;// ?????

	uint8_t row=0;
	uint8_t col=0;
	tx[kk++]=LCD_CO_MORE_CONTROL_BYTE_ON | LCD_INSTRUCTION_TYPE
			// | (((row & 0x01) << 6) | (col & 0x0f))
			 ; //0x80
	tx[kk++]=0b00010000;// ?????
	/*tx[kk++]=LCD_EXT_MODE_IS1_INTERNAL_OSC_FREQUENCY //0b00010000
			| LCD_EXT_MODE_IS1_INTERNAL_OSC_FREQUENCY_BS_1_5BIAS_ON
			//| LCD_EXT_MODE_IS1_INTERNAL_OSC_FREQUENCY_F2_ON
			//| LCD_EXT_MODE_IS1_INTERNAL_OSC_FREQUENCY_F2_ON
			//| LCD_EXT_MODE_IS1_INTERNAL_OSC_FREQUENCY_F2_ON
			;//  0b00010000; //*/

	/*char ddramAddr = (0x80 | (((row & 0x01) << 6) | (col & 0x0f)));
	char data[2] = {0x00, ddramAddr}; ??????*/

	//tx[2]=LCD_CO_MORE_CONTROL_BYTE_OFF | LCD_DATA_TYPE;
	//tx[kk++]=0;//LCD_DISPLAY_ON_OFF | LCD_DISPLAY_OFF_BIT | LCD_CURSOR_OFF_BIT | LCD_CURSOR_POSITION_OFF_BIT;//

	LCD_SendCommands(tx,kk);

	LCD_SendCommand(0xB0+numString); // Set DDRAM address 1011 XXXX

}

uint8_t LCD_print_String_prefix()
{
	uint8_t kk=0;

	tx[kk++]=LCD_CO_MORE_CONTROL_BYTE_ON
			| LCD_DATA_TYPE
			| 0;//0xC0
	tx[kk++]=0; // what is it? i don't know

	tx[kk++]=LCD_CO_MORE_CONTROL_BYTE_OFF
		| LCD_DATA_TYPE //  0X40
		;
	tx[kk++]=0;// what is it? i don't know

	/*tx[kk++]=LCD_CO_MORE_CONTROL_BYTE_OFF
		| LCD_SET_CGRAM_ADDRESS;*/
	//tx[kk++]=0;//0XFF;

	/*tx[kk++]=LCD_CO_MORE_CONTROL_BYTE_OFF
		| LCD_SET_CGRAM_ADDRESS+10;
	tx[kk++]=0;*/

	/*tx[4]=LCD_ENTRY_MODE_SET //These operations are performed during data write and read
				| LCD_ENTRY_MODE_SET_DECREMENT
				| LCD_ENTRY_MODE_SET_SHIFT_DISPLAY_OFF;
	//tx[2]=LCD_CO_MORE_CONTROL_BYTE_OFF | LCD_DATA_TYPE;
	tx[5]=0;//LCD_DISPLAY_ON_OFF | LCD_DISPLAY_OFF_BIT | LCD_CURSOR_OFF_BIT | LCD_CURSOR_POSITION_OFF_BIT;//
*/
	return kk;
}

void LCD_print_String(uint8_t *str,uint8_t numString,uint8_t reverseSymbols,uint8_t reverseSymbol)
{

	before_LCD_print(numString);

	uint8_t kk=LCD_print_String_prefix();

	uint8_t len=strlen(str);

	// width : 128 dots  = 25 symbols (5 dot) and 3 dots will remain
	// or 21 symbols (5 + 1 space between symbols) and 2 dots will remain  (offset)
	uint8_t offset=1;

	for(uint8_t ii=0; ii< LCD_SYMBOLS; ii++) //
	{
		uint8_t ch=0x00;
		if(ii < len )
			ch=str[ii];

		for(uint8_t ll=0; ll<6 ; ll++)
		{
			uint8_t b=0x00; ///space
			if(ll < LCD_SYMBOL_WIDTH)
			{
				if(reverseSymbol == LCD_REVERSE_SYMBOL_ON)
					b=FontTable[ch][4-ll];
				else
					b=FontTable[ch][ll];
			}

			if(reverseSymbols == LCD_REVERSE_SYMBOLS_ON)
				tx[(LCD_SYMBOLS-1-ii)*(LCD_SYMBOL_WIDTH+LCD_SPACE)+ll+kk+offset]=b;
			else
				tx[ii*(LCD_SYMBOL_WIDTH+LCD_SPACE)+ll+kk+offset]=b;
		}
	}

	LCD_SendDates(tx,128+kk);
}
void LCD_clear(uint8_t numString)
{
	before_LCD_print(numString);

	uint8_t kk=LCD_print_String_prefix();

	for(uint8_t ii=kk; ii< sizeof(tx); ii++)
	{
		tx[ii]=0x00;
	}
	LCD_SendDates(tx,128+kk);
}

void rst_LCD(void)
{

}

void LCD_enable(void)
{
	HAL_GPIO_WritePin(LCD_EN_GPIO_Port, LCD_EN_Pin, GPIO_PIN_RESET);
	HAL_Delay(500);

	HAL_GPIO_WritePin(LCD_EN_GPIO_Port, LCD_EN_Pin, GPIO_PIN_SET);
	HAL_Delay(500);
}

void LCD_Init(I2C_HandleTypeDef *h)
{
	rst_LCD();
	LCD_enable();

	pI2C_LCD=h;

	LCD_SendCommand(LCD_SET_DDRAM_ADDRESS
			| 	0b01100010); // 0xE2 Set DDRAM address 1100010

	uint8_t kk=0;

	txBuf[kk++]=LCD_CO_MORE_CONTROL_BYTE_ON | LCD_INSTRUCTION_TYPE;//0x80;
	txBuf[kk++]=LCD_DISPLAY_ON_OFF
			| LCD_DISPLAY_OFF_BIT
			| LCD_CURSOR_OFF_BIT
			| LCD_CURSOR_POSITION_OFF_BIT
			//|0b00001000
			;// Display OFF

	txBuf[kk++]=LCD_CO_MORE_CONTROL_BYTE_ON | LCD_INSTRUCTION_TYPE;//0x80;
	txBuf[kk++]=LCD_SET_CGRAM_ADDRESS
			| 000000
			//| 0b01000000
			; // 0x40 Set CGRAM 0000000

	txBuf[kk++]=LCD_CO_MORE_CONTROL_BYTE_ON | LCD_INSTRUCTION_TYPE;//0x80;
	txBuf[kk++]=LCD_FUNCTION_SET
			| LCD_FUNCTION_SET_DL_4BITS
			| LCD_FUNCTION_SET_N_1LINE
			| LCD_FUNCTION_SET_DH_DOUBLE_HEIGHT_OFF
			| LCD_FUNCTION_SET_TEST_BIT_ON
			| LCD_FUNCTION_SET_NORMAL_MODE;//0b00100010; // 22 Function Set

	/* NORMAL MODE */

	/*txBuf[kk++]=LCD_CO_MORE_CONTROL_BYTE_ON | LCD_INSTRUCTION_TYPE; //0x80;
	txBuf[kk++]=LCD_ENTRY_MODE_SET
		| LCD_ENTRY_MODE_SET_DECREMENT
		| LCD_ENTRY_MODE_SET_SHIFT_DISPLAY_OFF;*/

	txBuf[kk++]=LCD_CO_MORE_CONTROL_BYTE_ON | LCD_INSTRUCTION_TYPE;//0x80;
	txBuf[kk++]=LCD_SET_DDRAM_ADDRESS
			| 0b00100110 ;//0b10100110; // A6 Set DDRAM address 0100100

	txBuf[kk++]=LCD_CO_MORE_CONTROL_BYTE_ON | LCD_INSTRUCTION_TYPE;//0x80;
	txBuf[kk++]=LCD_FUNCTION_SET
			| LCD_FUNCTION_SET_DL_4BITS
			| LCD_FUNCTION_SET_N_2LINE
			| LCD_FUNCTION_SET_DH_DOUBLE_HEIGHT_ON
			| LCD_FUNCTION_SET_TEST_BIT_ON 	// не важно
			| LCD_FUNCTION_SET_EXTENSION_MODE  	// ВАЖНО
			;// 0b00101111; // 2F Function Set

	/* EXTENSION MODE */

	txBuf[kk++]=LCD_CO_MORE_CONTROL_BYTE_ON | LCD_INSTRUCTION_TYPE;//0x80;
	txBuf[kk++]=LCD_SET_DDRAM_ADDRESS | 0b00101111; // 0x4F 0b10101111; // AF Set DDRAM address 00101111


	LCD_SendCommands(txBuf,kk);

	/* MY */
	//LCD_SendCommand(LCD_CLEAR_DISPLAY);

	return;
}

void LCD_SendCommands(uint8_t *buf, uint8_t size)
{
	HAL_StatusTypeDef res;

	printf(">> ");

	for(int jj=0; jj < size; jj++)
	{
		printf("0x%.2X ",*(buf+jj));
	}

	printf("\n");

	HAL_I2C_Master_Transmit(pI2C_LCD, LCD_ADDR, buf, size , HAL_MAX_DELAY);
	//HAL_Delay(1);
}

void LCD_SendDates(uint8_t* buf, uint8_t size)
{
	HAL_StatusTypeDef res;
	printf("-> ");

	for(int jj=0; jj < size; jj++)
	{
		printf("%.2X ",*(buf+jj));
	}

	printf("\n");

	res = HAL_I2C_Master_Transmit(pI2C_LCD, LCD_ADDR, buf, size, HAL_MAX_DELAY);

	if(res!=HAL_OK)
	{
		printf(" err Transmit %s\n");
	}
}


void LCD_SendCommand( uint8_t cmd)
{
	uint8_t data[2];
	data[0]=0x80;
	data[1]=cmd;

	HAL_I2C_Master_Transmit(pI2C_LCD, LCD_ADDR, (uint8_t*)data, sizeof(data) , HAL_MAX_DELAY);

	HAL_Delay(10);
}


void I2C_Scan(char *str,I2C_HandleTypeDef *pH)
{
	HAL_StatusTypeDef res;
	printf("%s pH= %x  : ",str,pH);

	for(uint16_t address = 0; address < 128 ; address++)
	{
		/*if(address==0x3e)
				continue;*/

		res = HAL_I2C_IsDeviceReady(pH, address << 1  , 1, 100);//HAL_MAX_DELAY);

		if(res == HAL_OK)
		{
			printf("device address 0x%x ",address << 1);
		}
	}
	printf("\n");
}


